## boards/shields/jojos_macropad/Kconfig.defconfig
```kconfig
if SHIELD_JOJOS_MACROPAD

config ZMK_KEYBOARD_NAME
    default "jojos-macropad"

endif # SHIELD_JOJOS_MACROPAD
```

## boards/shields/jojos_macropad/Kconfig.shield
```kconfig
config SHIELD_JOJOS_MACROPAD
    def_bool $(shields_list_contains,jojos_macropad)
```
