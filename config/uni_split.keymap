// Miryoku keymap for the uni-split.
//
// The uni-split is a 36-key 5x3+3 keyboard, so it uses the minidox mapping:
// three rows of 10 keys plus 6 thumb keys, in the same order as the
// uni_split matrix transform.
//
// Base alphas: QWERTY
// Nav layer:   VI (HJKL navigation)
// See config/miryoku/custom_config.h.

#include "miryoku/custom_config.h"
#include "miryoku/mapping/36/minidox.h"
#include "miryoku/miryoku.dtsi"
